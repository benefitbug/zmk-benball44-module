## boards/shields/benball44/Kconfig.defconfig
```kconfig
Kconfig.defconfig
if SHIELD_BENBALL44_RIGHT

# Name must be less than 16 characters long!
config ZMK_KEYBOARD_NAME
    default "benball44"

config ZMK_SPLIT_ROLE_CENTRAL
    default y

endif

if SHIELD_BENBALL44_LEFT || SHIELD_BENBALL44_RIGHT

config ZMK_SPLIT
    default y

endif
```

## boards/shields/benball44/Kconfig.shield
```kconfig
# No whitespace after the comma or in your part name!
config SHIELD_BENBALL44_LEFT
    def_bool $(shields_list_contains,benball44_left)

# No whitespace after the comma or in your part name!
config SHIELD_BENBALL44_RIGHT
    def_bool $(shields_list_contains,benball44_right)
```
